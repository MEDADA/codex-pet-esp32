## main/Kconfig.projbuild
```kconfig
menu "Rem Companion"
config BUDDY_PET_V11
    bool "Use Pet V11.1 stage (LVGL 9)"
    default n
    help
        Select the supplied static pet stage with existing Bridge and details.
        Disable to rebuild the preserved Rem UI. IMU is a later phase.
config BUDDY_PET_V11_ANIMATION
    bool "Enable lightweight V11.1 blink and state cues"
    depends on BUDDY_PET_V11
    default y
    help
        Disable to return to the static P0 view without changing Bridge logic.
config BUDDY_PET_V11_IMU
    bool "Enable QMI8658 six-axis glint cues"
    depends on BUDDY_PET_V11
    default y
    help
        Uses a stable 2-second neutral calibration. BOOT long press recalibrates.
        Glints are visual proxies, not real eye tracking. Disable to return to P1.

config BUDDY_VOICE_BRIDGE
    bool "Enable Mac voice bridge (Wi-Fi + HTTP PCM audio)"
    default n if BUDDY_PET_V11
    default y
    help
        Rem companion only. Pulls in the Wi-Fi driver, the setup portal, the
        HTTP voice client and the ES8311 speaker path. Pet V11.1 has no voice
        UI, so leaving it off frees internal RAM and keeps the radio idle.
        Rem builds default to on; the pet stage defaults to off.

config BUDDY_WIFI_SSID
    string "Initial Wi-Fi SSID (optional; can provision on device)"
    default ""
config BUDDY_WIFI_PASSWORD
    string "Initial Wi-Fi password"
    default ""
config BUDDY_VOICE_URL
    string "Mac voice bridge URL (http://LAN-IP:8765)"
    default ""
config BUDDY_VOICE_TOKEN
    string "Voice bridge device bearer token"
    default ""
endmenu
```

## sdkconfig.defaults
```kconfig
CONFIG_ESPTOOLPY_FLASHMODE_QIO=y
CONFIG_ESPTOOLPY_FLASHSIZE_32MB=y
CONFIG_PARTITION_TABLE_CUSTOM=y
CONFIG_COMPILER_OPTIMIZATION_PERF=y
CONFIG_SPIRAM=y
CONFIG_SPIRAM_MODE_OCT=y
CONFIG_SPIRAM_FETCH_INSTRUCTIONS=n
CONFIG_SPIRAM_RODATA=n
CONFIG_SPIRAM_SPEED_80M=y
CONFIG_SPIRAM_XIP_FROM_PSRAM=n
CONFIG_ESP32S3_INSTRUCTION_CACHE_32KB=y
CONFIG_ESP32S3_DATA_CACHE_64KB=y
CONFIG_ESP_DEFAULT_CPU_FREQ_MHZ_240=y
CONFIG_ESP32S3_DATA_CACHE_LINE_64B=y
CONFIG_FREERTOS_HZ=1000

CONFIG_BT_ENABLED=y
CONFIG_BT_NIMBLE_ENABLED=y
CONFIG_BT_CONTROLLER_ENABLED=y
CONFIG_BTDM_CTRL_MODE_BLE_ONLY=y
CONFIG_BT_NIMBLE_ROLE_PERIPHERAL=y
CONFIG_BT_NIMBLE_MAX_CONNECTIONS=1
CONFIG_BT_NIMBLE_GATT_MAX_PROCS=8
CONFIG_BT_NIMBLE_ATT_PREFERRED_MTU=23
CONFIG_BT_NIMBLE_SV_DISABLE_LEGACY=n

CONFIG_LV_USE_CLIB_MALLOC=y
CONFIG_LV_USE_CLIB_STRING=y
CONFIG_LV_USE_CLIB_SPRINTF=y
CONFIG_LV_DEF_REFR_PERIOD=30
CONFIG_LV_OS_FREERTOS=y
CONFIG_LV_FONT_MONTSERRAT_14=y
CONFIG_LV_FONT_MONTSERRAT_20=y
CONFIG_LV_FONT_MONTSERRAT_28=y
CONFIG_LV_FONT_MONTSERRAT_36=y
CONFIG_LV_FONT_DEFAULT_MONTSERRAT_20=y
CONFIG_IDF_EXPERIMENTAL_FEATURES=y

# Buddy BLE self-heal / headroom (CodeIsland can still burst status frames)
CONFIG_BT_NIMBLE_PINNED_TO_CORE_0=y
CONFIG_BT_NIMBLE_MSYS_1_BLOCK_COUNT=24
CONFIG_BT_NIMBLE_MSYS_2_BLOCK_COUNT=48
CONFIG_BT_NIMBLE_TRANSPORT_ACL_FROM_LL_COUNT=48
CONFIG_BT_NIMBLE_TRANSPORT_EVT_COUNT=50

CONFIG_LV_USE_TJPGD=y
CONFIG_LV_CACHE_DEF_SIZE=524288

# CONFIG_LV_USE_FREETYPE is not set

CONFIG_LV_DRAW_THREAD_STACK_SIZE=32768

# SPIFFS: 256-byte pages overflow page_ix at 16MB; keep headroom
CONFIG_SPIFFS_PAGE_SIZE=512

# Keep internal RAM for SPI LCD DMA (rem companion + WiFi + NimBLE pressure)
CONFIG_SPIRAM_MALLOC_ALWAYSINTERNAL=4096
CONFIG_SPIRAM_MALLOC_RESERVE_INTERNAL=131072
CONFIG_ESP_WIFI_DYNAMIC_RX_BUFFER_NUM=16
CONFIG_ESP_WIFI_DYNAMIC_TX_BUFFER_NUM=16
CONFIG_ESP_TASK_WDT_TIMEOUT_S=30

# Required for TJPGD to decode C-array JPEG backgrounds
CONFIG_LV_USE_FS_MEMFS=y
CONFIG_LV_FS_MEMFS_LETTER=77
```
